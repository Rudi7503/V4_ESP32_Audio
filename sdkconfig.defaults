## sdkconfig.defaults
```kconfig
#
# Bootloader config
#
CONFIG_BOOTLOADER_LOG_LEVEL_WARN=y

#
# Serial flasher config
#
CONFIG_ESPTOOLPY_FLASHFREQ_80M=y
CONFIG_ESPTOOLPY_FLASHFREQ="80m"

CONFIG_ESPTOOLPY_FLASHSIZE_4MB=y
CONFIG_ESPTOOLPY_FLASHSIZE="4MB"

#
# Partition Table
#
CONFIG_PARTITION_TABLE_CUSTOM=y
CONFIG_PARTITION_TABLE_CUSTOM_FILENAME="partitions.csv"
CONFIG_PARTITION_TABLE_FILENAME="partitions.csv"
CONFIG_PARTITION_TABLE_OFFSET=0xA000
# end of Partition Table

#
# FreeRTOS
#
CONFIG_FREERTOS_HZ=1000
# Fuer die CPU-Last-Messung ueber das "tasks"-Kommando der Konsole
# (esp_gmf_oal_sys_get_real_time_stats verlangt beide Optionen).
CONFIG_FREERTOS_GENERATE_RUN_TIME_STATS=y
CONFIG_FREERTOS_VTASKLIST_INCLUDE_COREID=y
# end of Kernel

CONFIG_ESP_BT_AUDIO_GMF_IO_SUPPORT=y

# CONFIG_SPIRAM is not set
```
